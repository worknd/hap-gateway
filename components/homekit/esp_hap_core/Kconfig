## components/homekit/esp_hap_core/Kconfig
```kconfig
menu "HomeKit"

    config HAP_SESSION_KEEP_ALIVE_ENABLE
        bool "Enable Keep Alive on sessions"
        default n
        help
            Enable Keep Alive on Controller Sessions so that stale connections do not stay
            open indefinitely. Note that the HomeKit Specs do not allow this and so, this
            should be enabled at your own risk. Even without this option, the HomeKit core
            will close stale session using the HTTP Server's Least Recently Used (LRU) purge
            logic.

endmenu
```

## components/homekit/esp_hap_platform/Kconfig
```kconfig
menu "HAP HTTP Server"

    config HAP_HTTP_STACK_SIZE
        int "Server Stack Size"
        default 12288
        range 8192 32768
        help
            Set the stack size for the HomeKit HTTP Server thread.

    config HAP_HTTP_SERVER_PORT
        int "Server Port"
        default 80
        help
            Set the HomeKit HTTP Server Port number.

    config HAP_HTTP_CONTROL_PORT
        int "Server Control Port"
        default 32859
        help
            Set the HomeKit HTTP Server UDP Control Port which is used for internl communication.

    config HAP_HTTP_MAX_OPEN_SOCKETS
        int "Max Open Sockets"
        default 8
        range 2 24
        help
            Set the Maximum simultaneous Open Sockets that the HTTP Server should allow.
            A minimum of 8 is required for HomeKit Certification.

    config HAP_HTTP_MAX_URI_HANDLERS
        int "Max URI Handlers"
        default 16
        range 12 32
        help
            Set the Maximum number of URI handlers that the HTTP Server should allow.

endmenu

menu "HAP Platform Keystore"

    config HAP_PLATFORM_DEF_NVS_RUNTIME_PARTITION
        string "Runtime NVS partition name"
        default "nvs"
        help
            Set the runtime NVS partition name for HomeKit use.

    config HAP_PLATFORM_DEF_NVS_FACTORY_PARTITION
        string "Factory NVS partition name"
        default "factory_nvs"
        help
            Set the factory NVS partition name for HomeKit use.

endmenu
```

## sdkconfig.defaults
```kconfig
CONFIG_IDF_EXPERIMENTAL_FEATURES=y

CONFIG_PARTITION_TABLE_CUSTOM=y
CONFIG_PARTITION_TABLE_CUSTOM_FILENAME="partitions_hap.csv"
CONFIG_PARTITION_TABLE_CUSTOM_APP_BIN_OFFSET=0x10000

CONFIG_FREERTOS_UNICORE=y
CONFIG_FREERTOS_ASSERT_ON_UNTESTED_FUNCTION=n
CONFIG_FREERTOS_ASSERT_FAIL_ABORT=n
CONFIG_FREERTOS_ASSERT_DISABLE=y

CONFIG_MBEDTLS_HARDWARE_MPI=y
CONFIG_MBEDTLS_HARDWARE_SHA=n
CONFIG_ESP_TASK_WDT=n
CONFIG_ESPTOOLPY_FLASHSIZE_4MB=y
CONFIG_MP_BLOB_SUPPORT=y
CONFIG_ENABLE_UNIFIED_PROVISIONING=n

CONFIG_BT_ENABLED=y
CONFIG_BTDM_CTRL_MODE_BLE_ONLY=y
CONFIG_BT_NIMBLE_ENABLED=y
CONFIG_BT_NIMBLE_ROLE_PERIPHERAL=n
CONFIG_BT_NIMBLE_ROLE_BROADCASTER=n
CONFIG_BT_NIMBLE_SVC_GAP_DEVICE_NAME="hap-gateway"

CONFIG_ETH_USE_SPI_ETHERNET=n
CONFIG_ESP_PHY_CALIBRATION_AND_DATA_STORAGE=n
CONFIG_ESP_COEX_POWER_MANAGEMENT=y
CONFIG_PM_ENABLE=y

CONFIG_ESP_WIFI_SOFTAP_SUPPORT=n
CONFIG_ESP_WIFI_11KV_SUPPORT=y
CONFIG_ESP_WIFI_11R_SUPPORT=y
CONFIG_ESP_WIFI_SCAN_CACHE=y
CONFIG_ESP_WIFI_MBO_SUPPORT=y
CONFIG_ESP_WIFI_ENABLE_ROAMING_APP=y
CONFIG_ESP_WIFI_ROAMING_SCAN_MONITOR_INTERVAL=300
CONFIG_ESP_WIFI_ROAMING_RRM_MONITOR_TIME=300

CONFIG_LWIP_LOCAL_HOSTNAME="hap-gateway"
CONFIG_LWIP_AUTOIP=y
CONFIG_LWIP_AUTOIP_RATE_LIMIT_INTERVAL=60
CONFIG_LWIP_MAX_SOCKETS=16
CONFIG_LWIP_SO_REUSE=y
CONFIG_LWIP_MAX_ACTIVE_TCP=12
CONFIG_LWIP_MAX_LISTENING_TCP=12
CONFIG_LWIP_UDP_RECVMBOX_SIZE=10
```

## sdkconfig.defaults.esp32c3
```kconfig
CONFIG_BOOT_GPIO=9
CONFIG_BLINK_GPIO=8
CONFIG_ESP_PHY_MAX_WIFI_TX_POWER=11
CONFIG_ESP_PHY_REDUCE_TX_POWER=y
```
