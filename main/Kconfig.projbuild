## main/Kconfig.projbuild
```kconfig
menu "HAP-Gateway Configuration"

    orsource "$IDF_PATH/examples/common_components/env_caps/$IDF_TARGET/Kconfig.env_caps"

    choice SENSOR_TYPE
        prompt "Type of sensor"
        default SENSOR_XIAOMI2
        help
            Select the sensor type.

        config SENSOR_XIAOMI2
            bool "Xiaomi 2 sensor by BLE (LYWSD03MMC)"
        config SENSOR_DHT11
            bool "DHT11/12 sensor by GPIO"
        config SENSOR_DHT22
            bool "DHT22/21 sensor by GPIO"
        config SENSOR_AHTX0
            bool "AHT10/20 sensor by I2C"
    endchoice

    config SENSOR_GPIO
        int "Sensor GPIO number"
        range ENV_GPIO_RANGE_MIN ENV_GPIO_OUT_RANGE_MAX
        default 4
        depends on (SENSOR_DHT11 || SENSOR_DHT22)
        help
            GPIO number (IOxx) to communicate with DHT11 sensor.

    config I2C_PORT
        int "I2C port number"
        range 0 1
        default 0
        depends on SENSOR_AHTX0
        help
            I2C port number to communicate with  I2C devices.

    config I2C_SCL_GPIO
        int "SCL GPIO number"
        range ENV_GPIO_RANGE_MIN ENV_GPIO_OUT_RANGE_MAX
        default 9
        depends on SENSOR_AHTX0
        help
            GPIO number (IOxx) to communicate with I2C devices.

    config I2C_SDA_GPIO
        int "SDA GPIO number"
        range ENV_GPIO_RANGE_MIN ENV_GPIO_OUT_RANGE_MAX
        default 8
        depends on SENSOR_AHTX0
        help
            GPIO number (IOxx) to communicate with I2C devices.

    config I2C_FREQUENCY
        int "I2C frequency"
        range 10000 1000000
        default 100000
        depends on SENSOR_AHTX0
        help
            I2C frequency to communicate with I2C devices.

    config I2C_AHTX0_ADDRESS
        hex "I2C address of AHT10/20 sensor"
        default 0x38
        depends on SENSOR_AHTX0
        help
            I2C address of AHT10/20 sensor.

    config I2C_BMP280_ADDRESS
        hex "I2C address of BMP280 sensor"
        default 0x77
        depends on SENSOR_AHTX0
        help
            I2C address of BMP280 sensor.

    config BLINK_GPIO
        int "Blink GPIO number"
        range ENV_GPIO_RANGE_MIN ENV_GPIO_OUT_RANGE_MAX
        default 8 if IDF_TARGET_ESP32C3
        default 2
        help
            GPIO number (IOxx) to blink on and off the LED.

    config BOOT_GPIO
        int "Boot button GPIO number"
        range ENV_GPIO_RANGE_MIN ENV_GPIO_IN_RANGE_MAX
        default 9 if IDF_TARGET_ESP32C3
        default 0
        help
            GPIO number (IOxx) for BOOT button.
            Some GPIOs are used for other purposes (flash connections, etc.) and cannot be used.

    config SENSOR_INQUERY_TIMEOUT
        int "Sensor inquery timeout in minutes"
        range 1 30
        default 1
        help
            Timeout for pereodic refreshing sensor values in minutes.

    config APP_WIFI_SSID
        string "WiFi SSID"
        default "your-ssid"
        help
            SSID (network name) for the example to connect to.

    config APP_WIFI_PASSWORD
        string "WiFi Password"
        default "your-pw"
        help
            WiFi password (only WPA2!) for the example to use.

    config EXAMPLE_USE_HARDCODED_SETUP_CODE
        bool "Use hard-coded setup code"
        default y
        help
            HomeKit does not recommend having the setup code programmed in the accessory as is.
            Instead, it expects setup info (salt-verifier pair) generated for the given setup code.
            Use this option only for testing purposes. For production, the setup info should be
            used.

    config EXAMPLE_SETUP_CODE
        string "HomeKit Setup Code"
        default "111-22-333"
        depends on EXAMPLE_USE_HARDCODED_SETUP_CODE
        help
            Setup code to be used for HomeKot pairing, if hard-coded setup code is enabled.

    config EXAMPLE_SETUP_ID
        string "HomeKit Setup Id"
        default "ND01"
        depends on EXAMPLE_USE_HARDCODED_SETUP_CODE
        help
            Setup id to be used for HomeKot pairing, if hard-coded setup code is enabled.

endmenu
```
